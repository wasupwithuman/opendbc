VERSION ""

NS_ :

BS_:

BU_: XXX

BO_ 494 : 8 XXX

BO_ 492 engine, RPMs: 8 XXX
 SG_ RPMs : 40|7@1- (1,0) [0|255] "" XXX

BO_ 500 NEW_MSG_1: 8 XXX

BO_ 740 Speed: 8 XXX
 SG_ Speed : 7|8@0- (1,0) [0|255] "" XXX

BO_ 742 speed: 8 XXX
 SG_ Speed : 7|8@0- (1,0) [0|255] "" XXX

CM_ SG_ 492 RPMs "RPMs";
CM_ SG_ 740 Speed "Not sure what side.";
CM_ SG_ 742 Speed "Not sure what side";
